## gasket/Kconfig
```kconfig
# SPDX-License-Identifier: GPL-2.0
menu "Gasket devices"

config GASKET
	tristate "Gasket framework"
	depends on PCI && (X86_64 || ARM64)
	default m
	help
	  This framework supports Gasket-compatible devices, such as Apex.
	  It is required for any of the following module(s).

	  To compile this driver as a module, choose M here.  The module
	  will be called "gasket".

config APEX
	tristate "Apex Driver"
	depends on GASKET
	default m
	help
	  This driver supports the Apex Edge TPU device.  See
	  https://cloud.google.com/edge-tpu/ for more information.
	  Say Y if you want to include this driver in the kernel.

	  To compile this driver as a module, choose M here.  The module
	  will be called "apex".

endmenu
```
